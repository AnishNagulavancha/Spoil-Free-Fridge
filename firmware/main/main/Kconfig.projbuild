## firmware/main/main/Kconfig.projbuild
```kconfig
menu "Spoil-Free Fridge Wi-Fi"

config ESP_WIFI_SSID
    string "Wi-Fi SSID"
    default ""

config ESP_WIFI_PASSWORD
    string "Wi-Fi password"
    default ""

config ESP_MAXIMUM_RETRY
    int "Maximum connection retries"
    range 1 20
    default 5

config SPOIL_FREE_ENABLE_LIGHT_SLEEP
    bool "Use light sleep during inactive cycle period"
    default y

config SENSOR_TRANSFER_GRACE_MS
    int "Maximum sensor-data transfer grace period (ms)"
    range 0 60000
    default 10000

endmenu
```
